## config/west.yml
```yaml
manifest:
  remotes:
    - name: zmkfirmware
      url-base: https://github.com/zmkfirmware
    - name: inorichi
      url-base: https://github.com/inorichi
    - name: yisheng-zmk
      url-base: https://github.com/yisheng-zmk
  projects:
    - name: zmk
      remote: zmkfirmware
      revision: main
      import: app/west.yml
    - name: zmk-pmw3610-driver
      remote: inorichi
      revision: main
    - name: zmk-config-keyball
      remote: yisheng-zmk
      revision: main
  self:
    path: config
```
